## app/boards/shields/slicemk_ergodox/Kconfig.defconfig
```kconfig
if SHIELD_SLICEMK_ERGODOX_DONGLE || SHIELD_SLICEMK_ERGODOX_LEFTCENTRAL || SHIELD_SLICEMK_ERGODOX_LEFTSINGLE || SHIELD_SLICEMK_ERGODOX_LEFTPERIPHERAL || SHIELD_SLICEMK_ERGODOX_RIGHTCENTRAL || SHIELD_SLICEMK_ERGODOX_RIGHTSINGLE || SHIELD_SLICEMK_ERGODOX_RIGHTPERIPHERAL

config ZMK_BLE
	default y

config ZMK_USB
	default y

endif

if SHIELD_SLICEMK_ERGODOX_DONGLE || SHIELD_SLICEMK_ERGODOX_LEFTCENTRAL || SHIELD_SLICEMK_ERGODOX_LEFTSINGLE || SHIELD_SLICEMK_ERGODOX_RIGHTCENTRAL || SHIELD_SLICEMK_ERGODOX_RIGHTSINGLE

config ZMK_KEYBOARD_NAME
	default "SliceMK ErgoDox"

endif

if SHIELD_SLICEMK_ERGODOX_DONGLE || SHIELD_SLICEMK_ERGODOX_LEFTCENTRAL || SHIELD_SLICEMK_ERGODOX_RIGHTCENTRAL

config ZMK_SPLIT
	default y

config ZMK_SPLIT_ROLE_CENTRAL
	default y

endif

if SHIELD_SLICEMK_ERGODOX_LEFTPERIPHERAL || SHIELD_SLICEMK_ERGODOX_RIGHTPERIPHERAL

config ZMK_SPLIT
	default y

endif
```
